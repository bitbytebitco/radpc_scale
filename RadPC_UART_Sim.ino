//char header[] = {0x4d, 0x6f, 0x6e, 0x74, 0x61, 0x6e, 0x61, 0x20, 0x53, 0x74, 0x61, 0x74, 0x65,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 0x47, 0x41};
//char packet[] = {0x0, 0x0, 0x0, 0x0, 0x0, 0x0, 0x0, 0x0, 0x6, 0x66, 0x3, 0xea, 0xb,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 0x0, 0x0};

char packet[] = {'00', '00', '00', '00', '00', '00', '00', '00', '06', '66', '03', 'ea', '0b', '85', '04', 'e8', '08', '07', '00', '00', '0a', '9f', '01', '74', '08', '2a', '05', 'c6', '00', '07', '00', '00', '00', '00', '00', '00', '00', '00', '00', '00', '00', '00', '00', '00', '00', '00', '00', '00', '00', '00', '00', '00', '00', '00', '00', '00', '00', '00', '00', '00', '00', '00', '00', '00', '00', '00', '00', '00', '00', '00', '00', '00', '00', '00', '00', '00', '00', '00', '00', '00', '00', '00', '00', '00', '00', '00', '00', '00', '00', '00', '00', '00', '00', '00', '00', '00', '00', '00', '00', '00', '00', '00', '00', '00', '00', '00', '00', '00', '00', '00', '00', '00', '00', '00', '00', '00', '00', '00', '00', '00', '00', '00', '00', '00', '00', '00', '00', '00', '00', '00', '00', '00', '00', '00', '00', '00', '00', '00', '00', '00', '00', '00', '00', '00', '00', '00', '00', '00', '00', '00', '00', '00', '00', '00', '00', '00', '00', '00', '00', '00', '00', '00', '00', '00', '00', '00', '00', '00', '00', '00', '00', '00', '00', '00', '00', '00', '00', '00', '00', '00', '00', '00', '00', '00', '00', '00', '00', '00', '00', '00', '00', '00', '00', '00', '00', '00', '00', '00', '00', '00', '00', '00', '00', '00', '00', '00', '00', '00', '00', '00', '00', '00', '00', '00', '00', '00'};

int incomingByte = 0;
int led = 8;

void setup() {
  Serial.begin(9600);
  pinMode(led, OUTPUT);  
}

void cycleLED(){
  digitalWrite(led, HIGH);   // turn the LED on (HIGH is the voltage level)
  delay(10);               // wait for a second
  digitalWrite(led, LOW);    // turn the LED off by making the voltage LOW
  delay(10);
  digitalWrite(led, HIGH);   // turn the LED on (HIGH is the voltage level)
  delay(10);               // wait for a second
  digitalWrite(led, LOW);    // turn the LED off by making the voltage LOW
  delay(10);
  digitalWrite(led, HIGH);   // turn the LED on (HIGH is the voltage level)
  delay(10);               // wait for a second
  digitalWrite(led, LOW);    // turn the LED off by making the voltage LOW
}

void loop() {
  int i,j;

  if (Serial.available() > 0) {
    // read the incoming byte:
    incomingByte = Serial.read();
        
    if(isHexadecimalDigit(incomingByte)){
      //cycleLED();
      for(i=0; i<sizeof packet; i++){
        //Serial.println(header[i]);
        //Serial.write(packet[i]);
        Serial.write(packet[i]);
        //delay(200);
      }
      Serial.print("\n");
      Serial.flush();
    }
    
  }
 
}
